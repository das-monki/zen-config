## config/west.yml
```yaml
manifest:
  remotes:
    - name: zmkfirmware
      url-base: https://github.com/wocka-flaka
  projects:
    - name: zmk-zen
      remote: zmkfirmware
      revision: Board-Corne-ish-Zen-dedicated-work-queue
      import: app/west.yml
  self:
    path: config
```
